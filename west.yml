## west.yml
```yaml
manifest:
  remotes:
    - name: zmkfirmware
      url-base: https://github.com/zmkfirmware
  projects:
    - name: zmk
      remote: zmkfirmware
      # right before introduction of soft-off which prevents this keyboard from waking after deep sleep
      revision: 58ccc5970dc804857d81609857d4217278ec025c 
      import: app/west.yml
  self:
    path: config
```
